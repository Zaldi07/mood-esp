## firmware/main/Kconfig.projbuild
```kconfig
menu "CarMood Board Config"

config CARMOOD_OLED_I2C_PORT
    int "OLED I2C Port"
    range 0 1
    default 0

config CARMOOD_OLED_I2C_SDA
    int "OLED I2C SDA GPIO"
    default 8

config CARMOOD_OLED_I2C_SCL
    int "OLED I2C SCL GPIO"
    default 9

config CARMOOD_OLED_I2C_ADDR
    hex "OLED I2C Address"
    default 0x3C

config CARMOOD_OLED_COLUMN_OFFSET
    int "OLED Column Offset (0 for SSD1306, 2 for SH1106)"
    range 0 10
    default 0

config CARMOOD_LIS3DH_I2C_PORT
    int "LIS3DH I2C Port"
    range 0 1
    default 0

config CARMOOD_LIS3DH_I2C_SDA
    int "LIS3DH I2C SDA GPIO"
    default 8

config CARMOOD_LIS3DH_I2C_SCL
    int "LIS3DH I2C SCL GPIO"
    default 9

config CARMOOD_LIS3DH_I2C_FREQ_HZ
    int "LIS3DH I2C Frequency (Hz)"
    range 10000 1000000
    default 400000

config CARMOOD_TOUCH_GPIO
    int "Touch Sensor Digital GPIO (e.g. TTP223)"
    range 0 21
    default 7

config CARMOOD_LIS3DH_REZERO_HOLD_MS
    int "长按触发重标定时长（毫秒）"
    range 200 5000
    default 1200

config CARMOOD_LIS3DH_CALIB_STEP_MS
    int "方向标定每步时长（毫秒）"
    range 500 10000
    default 3500

config CARMOOD_LIS3DH_CALIB_GAP_MS
    int "方向标定步骤间隔（毫秒）"
    range 100 5000
    default 800

endmenu

menu "CarMood Wi-Fi Config"

config CARMOOD_WIFI_SSID
    string "Wi-Fi SSID"
    default "IQOO 13"
    help
        用于联网校时（NTP）的 Wi-Fi 名称。

config CARMOOD_WIFI_PASSWORD
    string "Wi-Fi Password"
    default "88888888"
    help
        用于联网校时（NTP）的 Wi-Fi 密码。

config CARMOOD_TIME_SYNC_ON_BOOT
    bool "开机自动联网校时"
    default y
    help
        启用后，设备启动时会尝试连接 Wi-Fi 并进行 NTP 校时。

config CARMOOD_TIME_SYNC_TIMEOUT_SEC
    int "联网/校时超时时间（秒）"
    range 3 120
    default 30
    help
        Wi-Fi 连接与 NTP 等待的超时时间。

config CARMOOD_NTP_SERVER
    string "NTP Server"
    default "ntp.aliyun.com"
    help
        设备用于校时的 NTP 服务器地址。

config CARMOOD_TIME_TZ
    string "Timezone (TZ env)"
    default "CST-8"
    help
        C 标准库时区字符串。中国可用 CST-8。

config CARMOOD_NIGHT_SLEEP_ENABLED
    bool "深夜自动息屏"
    default y
    help
        启用后，设备在本地时间落入深夜时段时，会按 5 秒无操作规则自动息屏。
        离开深夜时段后，屏幕会自动恢复显示。

config CARMOOD_NIGHT_SLEEP_START_HOUR
    int "深夜自动息屏开始小时"
    range 0 23
    default 18
    help
        本地时间达到该小时后开始启用深夜自动息屏。

config CARMOOD_NIGHT_SLEEP_START_MINUTE
    int "深夜自动息屏开始分钟"
    range 0 59
    default 30
    help
        深夜自动息屏开始时的分钟数。

config CARMOOD_NIGHT_SLEEP_END_HOUR
    int "深夜自动息屏结束小时"
    range 0 23
    default 9
    help
        本地时间到达该小时后结束深夜自动息屏。

config CARMOOD_NIGHT_SLEEP_END_MINUTE
    int "深夜自动息屏结束分钟"
    range 0 59
    default 30
    help
        深夜自动息屏结束时的分钟数。

endmenu

menu "CarMood Touch Config"

config CARMOOD_TOUCH_SAMPLE_MS
    int "触摸采样周期（毫秒）"
    range 5 200
    default 20
    help
        触摸采样周期。越小响应越快，但日志与 CPU 占用会略增。

config CARMOOD_TOUCH_PRESS_THRESHOLD
    int "按下阈值（delta >=）"
    range 50 20000
    default 300
    help
        当 delta >= 本值时，认为采样点满足“按下条件”。

config CARMOOD_TOUCH_RELEASE_THRESHOLD
    int "释放阈值（delta <=）"
    range -1000 10000
    default 120
    help
        当 delta <= 本值时，认为采样点满足“释放条件”。
        该值应小于按下阈值，用于滞回防抖。

config CARMOOD_TOUCH_DEBOUNCE_COUNT
    int "去抖计数（连续样本数）"
    range 1 20
    default 3
    help
        连续满足条件多少次才确认状态切换。

config CARMOOD_TOUCH_CLICK_MIN_MS
    int "有效点击最短时长（毫秒）"
    range 10 2000
    default 40
    help
        按下时长小于该值会被忽略（过滤毛刺）。

config CARMOOD_TOUCH_CLICK_MAX_MS
    int "有效点击最长时长（毫秒）"
    range 50 5000
    default 800
    help
        按下时长大于该值会被忽略（过滤长按）。

config CARMOOD_TOUCH_MIN_GAP_MS
    int "点击最小间隔（毫秒）"
    range 50 5000
    default 250
    help
        两次有效点击之间的最小时间间隔，用于抑制重复触发。

config CARMOOD_TOP_DOUBLE_CLICK_MS
    int "顶部双击识别窗口（毫秒）"
    range 120 1000
    default 500
    help
        顶部第二次点击若在该窗口内释放，则识别为双击并直接进入 Astra 菜单。

config CARMOOD_MENU_BACK_HOLD_MS
    int "菜单/页面返回长按时长（毫秒）"
    range 200 2000
    default 500
    help
        菜单中顶部长按返回，以及打飞机模式顶部长按退出所使用的触发时长。

config CARMOOD_DEBUG_PERIODIC_LOG
    bool "开启周期性调试日志（touch/LIS3DH）"
    default n
    help
        关闭时仅保留关键事件日志（如点击、方向变化、错误）。
        开启后会周期打印触摸与加速度原始数据，便于调试。

endmenu
```

## firmware/sdkconfig.defaults
```kconfig
CONFIG_IDF_TARGET="esp32c3"
CONFIG_ESPTOOLPY_FLASHSIZE_4MB=y
CONFIG_PARTITION_TABLE_CUSTOM=y
CONFIG_PARTITION_TABLE_CUSTOM_FILENAME="partitions.csv"
CONFIG_PARTITION_TABLE_FILENAME="partitions.csv"

CONFIG_CARMOOD_OLED_I2C_PORT=0
CONFIG_CARMOOD_OLED_I2C_SDA=8
CONFIG_CARMOOD_OLED_I2C_SCL=9
CONFIG_CARMOOD_OLED_I2C_ADDR=0x3C
CONFIG_CARMOOD_OLED_COLUMN_OFFSET=2

CONFIG_CARMOOD_LIS3DH_I2C_PORT=0
CONFIG_CARMOOD_LIS3DH_I2C_SDA=8
CONFIG_CARMOOD_LIS3DH_I2C_SCL=9
CONFIG_CARMOOD_LIS3DH_I2C_FREQ_HZ=400000

CONFIG_CARMOOD_TOUCH_GPIO=7

CONFIG_CARMOOD_WIFI_SSID="MIMI"
CONFIG_CARMOOD_WIFI_PASSWORD="MiMi88888888"
CONFIG_CARMOOD_TIME_SYNC_ON_BOOT=y
CONFIG_CARMOOD_TIME_SYNC_TIMEOUT_SEC=30
CONFIG_CARMOOD_NTP_SERVER="ntp.aliyun.com"
CONFIG_CARMOOD_TIME_TZ="CST-8"
CONFIG_CARMOOD_NIGHT_SLEEP_ENABLED=y
CONFIG_CARMOOD_NIGHT_SLEEP_START_HOUR=18
CONFIG_CARMOOD_NIGHT_SLEEP_START_MINUTE=30
CONFIG_CARMOOD_NIGHT_SLEEP_END_HOUR=9
CONFIG_CARMOOD_NIGHT_SLEEP_END_MINUTE=30
```
